## config/west.yml
```yaml
manifest:
  remotes:
    - name: zmkfirmware
      url-base: https://github.com/zmkfirmware
    - name: wittyrascal
      url-base: https://github.com/wittyrascal
  projects:
    - name: zmk
      remote: zmkfirmware
      revision: main
      import: app/manifest/zephyr/west.yml
    - name: miryoku_zmk
      remote: wittyrascal
      revision: master
  self:
    path: config
```
